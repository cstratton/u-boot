## configs/orangepi_pc_plus_defconfig
```kconfig
CONFIG_ARM=y
CONFIG_ARCH_SUNXI=y
#not sure if we really need FIT
CONFIG_FIT=y
CONFIG_SPL_I2C_SUPPORT=y
CONFIG_MACH_SUN8I_H3=y
CONFIG_DRAM_CLK=624
CONFIG_DRAM_ZQ=3881979
CONFIG_DRAM_ODT_EN=y
CONFIG_MMC_SUNXI_SLOT_EXTRA=2
CONFIG_DEFAULT_DEVICE_TREE="sun8i-h3-orangepi-pc-plus"
# CONFIG_SYS_MALLOC_CLEAR_ON_INIT is not set
CONFIG_CONSOLE_MUX=y
CONFIG_SPL=y
CONFIG_CMD_SF=y
CONFIG_CMD_SPI=y
# CONFIG_CMD_IMLS is not set
# CONFIG_CMD_FLASH is not set
# CONFIG_CMD_FPGA is not set
# CONFIG_SPL_DOS_PARTITION is not set
# CONFIG_SPL_ISO_PARTITION is not set
# CONFIG_SPL_EFI_PARTITION is not set
#not sure what these do
CONFIG_SPL_DOS_PARTITION=y
#CONFIG_SPL_ISO_PARTITION=y
#CONFIG_SPL_EFI_PARTITION=y
CONFIG_SPL_PARTITION_UUIDS=y
CONFIG_SUN8I_EMAC=y
CONFIG_SY8106A_POWER=y
CONFIG_SPL_SPI_SUNXI=y
CONFIG_DM_SPI_FLASH=y
CONFIG_SPI_FLASH=y
CONFIG_SPI_FLASH_MACRONIX=y
CONFIG_SPI_FLASH_WINBOND=y
CONFIG_DM_SPI=y
CONFIG_SUNXI_SPI=y
CONFIG_USB_EHCI_HCD=y
#more SPI
#CONFIG_SPL_SPI_FLASH_SUPPORT=y
#CONFIG_SPL_SPI_SUPPORT=y
#CONFIG_QSPI_BOOT is not set
#CONFIG_SPI_BOOT=y
#we need overlay support
CONFIG_OF_LIBFDT_OVERLAY=y
```
